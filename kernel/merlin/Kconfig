## kernel/merlin/Kconfig
```kconfig
# SPDX-License-Identifier: GPL-2.0-only
#
# MERLIN-V: in-kernel JIT VM with RISC-V bytecode.
# kernel/merlin/Kconfig

config MERLIN
	tristate "MERLIN-V in-kernel JIT VM"
	depends on NET
	select ANON_INODES
	select PERF_EVENTS
	help
	  MERLIN-V is an in-kernel JIT virtual machine whose bytecode is a
	  restricted profile of the RISC-V ISA.  On RISC-V hosts the verified
	  image runs pass-through; on other hosts it is JIT-compiled to the
	  native ISA.  The design motivation and architecture are documented in
	  docs/design/.

	  If unsure, say N.

config MERLIN_JIT_X86_64
	bool "MERLIN-V x86_64 host JIT"
	depends on MERLIN && X86_64
	default MERLIN
	help
	  Enables the x86_64 host JIT for MERLIN-V programs.  Without this,
	  MERLIN-V programs cannot be loaded on x86_64 (verification passes
	  but execution is rejected).

config MERLIN_JIT_RISCV
	bool "MERLIN-V RISC-V pass-through JIT"
	depends on MERLIN && RISCV
	default MERLIN
	help
	  Enables the RISC-V pass-through path.  On RISC-V, verified programs
	  run as native machine code with only relocation patching and I-cache
	  flush.  This is the zero-translation 1:1 path.

config MERLIN_SELFTEST
	bool "MERLIN-V built-in self-tests"
	depends on MERLIN
	help
	  Compile kernel self-tests for MERLIN-V.  Tests run at module load
	  and report to dmesg.  Useful for CI.

	  If unsure, say N.
```

## platforms/icicle-linux/sample-classifier/sample.yaml
```yaml
sample:
  name: MERLIN-V Icicle Kit (rv64) packet classifier
  description: >-
    Load a small MERLIN-V program through the /dev/merlin ioctl on
    a RISC-V Linux host (MPFS Icicle Kit), exercise the pass-through
    JIT path, and classify two synthetic Ethernet frames.

common:
  tags:
    - merlin
    - platform_icicle
  platform_allow:
    - mpfs_icicle/polarfire/u54
  harness: shell
  harness_config:
    type: multi_line
    ordered: true
    regex:
      - "classifier: opened /dev/merlin"
      - "classifier: loaded prog_fd=.*"
      - "ETH/IPv4 packet -> retval=2 \\(PASS\\)"
      - "ETH/RARP  packet -> retval=1 \\(DROP\\)"
      - "classifier: done"
  requires:
    - "merlin.ko module loaded (insmod /lib/modules/.../merlin.ko)"

tests:
  sample.merlin.platform.icicle.classifier: {}
```

## zephyr/merlin/Kconfig
```kconfig
# SPDX-License-Identifier: Apache-2.0
#
# Kconfig for the MERLIN-V Zephyr runtime.

config MERLIN
	bool "MERLIN-V in-kernel JIT VM (Zephyr runtime)"
	default n
	help
	  Enable the MERLIN-V runtime for Zephyr.  Verified RISC-V bytecode
	  is loaded at runtime and executed pass-through on RISC-V targets
	  (rv32imc).  On non-RISC-V Zephyr targets execution is rejected.

	  See docs/design/05-reference-platforms.md §6 for the strategic
	  framing of MERLIN-V on Zephyr.

if MERLIN

config MERLIN_MAX_PROGS
	int "Maximum simultaneously-loaded MERLIN-V programs"
	default 4
	range 1 32
	help
	  Static upper bound on loaded programs.  Each program occupies one
	  slot in the prog table.  Memory is allocated up-front from the
	  system heap on prog_load and freed on prog_unload.

config MERLIN_MAX_PROG_BYTES
	int "Maximum bytes of bytecode per program"
	default 16384
	range 256 65536
	help
	  Per-program text section cap, in bytes.  The default is the
	  rtos-rv32 profile cap (16 KiB).

config MERLIN_MAX_STACK_BYTES
	int "Verifier max stack frame size (bytes)"
	default 256
	range 64 4096
	help
	  Maximum allowed stack frame size for a MERLIN-V program on this
	  target.  The rtos-rv32 default is 256 bytes per
	  docs/design/02-isa-and-bytecode.md.

config MERLIN_LOG_LEVEL
	int "Verifier log verbosity"
	default 1
	range 0 2
	help
	  0 = none, 1 = brief (one line per program), 2 = verbose.

config MERLIN_SAMPLE_HELPERS
	bool "Compile sample helper implementations"
	default y
	help
	  Provide a small built-in helper set (printk, k_uptime_get, …)
	  suitable for smoke testing on a board with a serial console.

endif # MERLIN
```
