## CMakeLists.txt
```
# SPDX-License-Identifier: Apache-2.0
#
# sample-classifier — MERLIN-V packet-classifier bring-up on ESP32-C3.

cmake_minimum_required(VERSION 3.20.0)

# Pick up the out-of-tree merlin module.  Caller may override.
if(NOT DEFINED ENV{EXTRA_ZEPHYR_MODULES})
  set(ENV{EXTRA_ZEPHYR_MODULES}
      "${CMAKE_CURRENT_LIST_DIR}/../../../zephyr/merlin")
endif()

find_package(Zephyr REQUIRED HINTS $ENV{ZEPHYR_BASE})
project(merlin_esp32c3_classifier)

target_sources(app PRIVATE
  src/main.c
  src/classifier_blob.c
)
```

## sample.yaml
```
sample:
  name: MERLIN-V ESP32-C3 packet classifier
  description: >-
    Load a small MERLIN-V program into the runtime on ESP32-C3-DevKitM-1
    and classify two synthetic Ethernet frames.

common:
  tags:
    - merlin
    - platform_esp32c3
  platform_allow:
    - esp32c3_devkitm
  harness: console
  harness_config:
    type: multi_line
    ordered: true
    regex:
      - "classifier: boot on esp32c3"
      - "classifier: loaded id=.* insns=7"
      - "verdict=2 \\(PASS\\)"
      - "verdict=1 \\(DROP\\)"
      - "classifier: done"

tests:
  sample.merlin.platform.esp32c3.classifier: {}
```

## prj.conf
```kconfig
# SPDX-License-Identifier: Apache-2.0
CONFIG_MERLIN=y
CONFIG_MERLIN_SAMPLE_HELPERS=y
CONFIG_MERLIN_MAX_PROGS=4
CONFIG_MERLIN_MAX_PROG_BYTES=16384

CONFIG_PRINTK=y
CONFIG_MAIN_STACK_SIZE=4096
CONFIG_HEAP_MEM_POOL_SIZE=16384

# UTF-8 in printk for the verdict arrow
CONFIG_PRINTK_BUFFER_SIZE=128
```

## src/main.c
```c
/* SPDX-License-Identifier: Apache-2.0 */
/*
 * sample-classifier/src/main.c — ESP32-C3 packet-classifier demo.
 *
 * Loads classifier_blob.c at runtime, runs it against synthetic Ethernet
 * frames (one IPv4, one ARP), prints the verdict for each.  Demonstrates
 * the end-to-end load → verify → run path on a 400 KiB SRAM RV32IMC MCU
 * with no MMU.
 *
 * The classifier is the tiniest non-trivial filter that exercises the
 * verifier's pointer-provenance and forward-branch paths.  See
 * classifier_blob.c for the bytecode source.
 */

#include <zephyr/kernel.h>
#include <zephyr/sys/printk.h>

#include "merlin/merlin.h"

extern const uint8_t  classifier_blob[];
extern const uint32_t classifier_blob_len;

/* Two synthetic Ethernet headers used as the ctx pointer for the
 * classifier.  Only the high byte of EtherType at offset 12 matters
 * to the classifier.
 *
 * IPv4 EtherType = 0x0800   →  byte[12] = 0x08  → verdict = 2 (PASS)
 * ARP  EtherType = 0x0806   →  byte[12] = 0x08  → verdict = 2 (PASS)
 *
 * For the "DROP" case we use an EtherType that isn't IPv4-family, e.g.
 * RARP (0x8035) → byte[12] = 0x80 → verdict = 1 (DROP).
 *
 * (The point isn't a meaningful classification — it's that the program
 * dispatches based on packet contents the verifier proved came from
 * a typed pointer.)
 */
static const uint8_t pkt_ipv4[16] = {
	/* dst MAC */     0xff,0xff,0xff,0xff,0xff,0xff,
	/* src MAC */     0x02,0x00,0x00,0x00,0x00,0x01,
	/* etype hi/lo */ 0x08, 0x00,
	/* payload */     0x00, 0x00,
};

static const uint8_t pkt_rarp[16] = {
	0xff,0xff,0xff,0xff,0xff,0xff,
	0x02,0x00,0x00,0x00,0x00,0x01,
	0x80, 0x35,
	0x00, 0x00,
};

static const char *verdict_str(uint64_t v)
{
	switch (v) {
	case 1: return "DROP";
	case 2: return "PASS";
	default: return "?";
	}
}

int main(void)
{
	struct merlin_load_info info;
	merlin_prog_t *prog = NULL;
	uint64_t retval;
	int rc;

	printk("classifier: boot on esp32c3 (RV32IMC, no MMU)\n");

	rc = merlin_init();
	if (rc) {
		printk("merlin_init failed: %d\n", rc);
		return 0;
	}

	rc = merlin_prog_load(classifier_blob, classifier_blob_len,
			      NULL, &info, &prog);
	if (rc) {
		printk("merlin_prog_load failed rc=%d log='%s'\n",
		       rc, info.summary);
		return 0;
	}
	printk("classifier: loaded id=%u insns=%u\n",
	       info.prog_id, info.verified_insns);

#ifdef CONFIG_RISCV
	/* IPv4 packet: byte 12 == 0x08 → PASS */
	rc = merlin_prog_run(prog, (void *)pkt_ipv4, &retval);
	if (rc)
		printk("run(ipv4) failed: %d\n", rc);
	else
		printk("classifier: synthetic packet ETH/IPv4/TCP "
		       "\u2192 verdict=%llu (%s)\n",
		       (unsigned long long)retval, verdict_str(retval));

	/* RARP packet: byte 12 == 0x80 → DROP */
	rc = merlin_prog_run(prog, (void *)pkt_rarp, &retval);
	if (rc)
		printk("run(rarp) failed: %d\n", rc);
	else
		printk("classifier: synthetic packet ETH/ARP    "
		       "\u2192 verdict=%llu (%s)\n",
		       (unsigned long long)retval, verdict_str(retval));
#else
	(void)retval;
	printk("classifier: skip run (non-RISC-V host)\n");
#endif

	merlin_prog_unload(prog);
	printk("classifier: done\n");
	return 0;
}
```

## src/classifier_blob.c
```c
/* SPDX-License-Identifier: Apache-2.0 */
/*
 * classifier_blob.c — hand-rolled Elf32 containing the packet classifier.
 *
 * Source (see classifier_src.S):
 *
 *   classify(ctx):
 *      lbu  a1, 12(a0)         ; byte at offset 12 = high byte of EtherType
 *      addi a2, x0, 8          ; 8 == high byte of 0x0800 (IPv4)
 *      beq  a1, a2, +8         ; if IPv4, jump to PASS
 *      addi a0, x0, 1          ; DROP
 *      jalr x0, ra, 0
 *   pass:
 *      addi a0, x0, 2          ; PASS
 *      jalr x0, ra, 0
 *
 * The verifier accepts this on the rtos-rv32 profile.  It exercises:
 *  - PtrCtx-rooted load        (verifier load-address check)
 *  - constant materialisation  (addi from x0)
 *  - forward branch            (back-edges rejected; forward allowed)
 *  - two return paths
 *
 * Layout (228 bytes):
 *   0   .. 51   Elf32 Ehdr
 *  52   .. 63   pad to e_shoff = 64
 *  64   .. 183  Section headers (3 * 40)
 * 184   .. 211  .text.merlin.filter.classifier  (28 bytes)
 * 212   .. end  .shstrtab
 */

#include <stdint.h>

/* clang-format off */
__attribute__((aligned(8))) const uint8_t classifier_blob[] = {
	/* ---- Elf32 Ehdr (52 bytes) ---- */
	0x7f,'E','L','F',
	1,                  /* EI_CLASS = ELFCLASS32              */
	1,                  /* EI_DATA  = ELFDATA2LSB             */
	1,                  /* EI_VERSION                         */
	0,                  /* EI_OSABI                           */
	0,                  /* EI_ABIVERSION                      */
	0,0,0,0,0,0,0,      /* EI_PAD                             */
	1,0,                /* e_type     = ET_REL                */
	0xf3,0,             /* e_machine  = EM_RISCV (243)        */
	1,0,0,0,            /* e_version                          */
	0,0,0,0,            /* e_entry                            */
	0,0,0,0,            /* e_phoff                            */
	0x40,0,0,0,         /* e_shoff   = 64                     */
	0,0,0,0,            /* e_flags                            */
	52,0,               /* e_ehsize                           */
	0,0,                /* e_phentsize                        */
	0,0,                /* e_phnum                            */
	40,0,               /* e_shentsize                        */
	3,0,                /* e_shnum   = 3                      */
	2,0,                /* e_shstrndx = 2                     */

	/* pad to e_shoff (64) */
	0,0,0,0, 0,0,0,0, 0,0,0,0,

	/* ---- Section headers ---- */

	/* [0] NULL */
	0,0,0,0, 0,0,0,0, 0,0,0,0, 0,0,0,0,
	0,0,0,0, 0,0,0,0, 0,0,0,0, 0,0,0,0,
	0,0,0,0, 0,0,0,0,

	/* [1] .text.merlin.filter.classifier (offset=184, size=28) */
	1,0,0,0,            /* sh_name (offset 1 in shstrtab)     */
	1,0,0,0,            /* sh_type = SHT_PROGBITS             */
	6,0,0,0,            /* sh_flags = ALLOC|EXEC              */
	0,0,0,0,            /* sh_addr                            */
	0xb8,0,0,0,         /* sh_offset = 184                    */
	28,0,0,0,           /* sh_size = 28                       */
	0,0,0,0,            /* sh_link                            */
	0,0,0,0,            /* sh_info                            */
	4,0,0,0,            /* sh_addralign = 4                   */
	0,0,0,0,            /* sh_entsize                         */

	/* [2] .shstrtab (offset=212, size=42) */
	32,0,0,0,           /* sh_name (offset 32 in shstrtab)    */
	3,0,0,0,            /* sh_type = SHT_STRTAB               */
	0,0,0,0,            /* sh_flags                           */
	0,0,0,0,            /* sh_addr                            */
	0xd4,0,0,0,         /* sh_offset = 212                    */
	42,0,0,0,           /* sh_size = 42                       */
	0,0,0,0,            /* sh_link                            */
	0,0,0,0,            /* sh_info                            */
	1,0,0,0,            /* sh_addralign = 1                   */
	0,0,0,0,            /* sh_entsize                         */

	/* ---- Section data ---- */

	/* offset 184: .text.merlin.filter.classifier (28 bytes) */
	0x83,0x45,0xc5,0x00,   /* pc=0  lbu  a1, 12(a0)              */
	0x13,0x06,0x80,0x00,   /* pc=4  addi a2, x0, 8               */
	0x63,0x84,0xc5,0x00,   /* pc=8  beq  a1, a2, +8              */
	0x13,0x05,0x10,0x00,   /* pc=12 addi a0, x0, 1   (DROP)      */
	0x67,0x80,0x00,0x00,   /* pc=16 jalr x0, ra, 0               */
	0x13,0x05,0x20,0x00,   /* pc=20 addi a0, x0, 2   (PASS)      */
	0x67,0x80,0x00,0x00,   /* pc=24 jalr x0, ra, 0               */

	/* offset 212: .shstrtab (42 bytes)
	 *   "\0.text.merlin.filter.classifier\0.shstrtab\0"
	 *      ^0   ^1                              ^31
	 */
	0,
	'.','t','e','x','t','.','m','e','r','l','i','n','.',
	'f','i','l','t','e','r','.',
	'c','l','a','s','s','i','f','i','e','r',0,
	'.','s','h','s','t','r','t','a','b',0,
};
/* clang-format on */

const uint32_t classifier_blob_len = sizeof(classifier_blob);
```
